## conf/bblayers.conf.sample
```bitbake
# POKY_BBLAYERS_CONF_VERSION is increased each time build/conf/bblayers.conf
# changes incompatibly
POKY_BBLAYERS_CONF_VERSION = "2"

BBPATH = "${TOPDIR}"
BBFILES ?= ""

YOCTOROOT = "${@os.path.abspath(os.path.join("${TOPDIR}", os.pardir))}"

BBLAYERS ?= " \
  ${YOCTOROOT}/src/poky/meta \
  ${YOCTOROOT}/src/poky/meta-poky \
  ${YOCTOROOT}/src/poky/meta-yocto-bsp \
  ${YOCTOROOT}/src/meta-tegra \
  ${YOCTOROOT}/src/meta-acme \
  "
```

## conf/layer.conf
```bitbake
# We have a conf and classes directory, add to BBPATH
BBPATH .= ":${LAYERDIR}"

# We have recipes-* directories, add to BBFILES
BBFILES += "${LAYERDIR}/recipes-*/*/*.bb \
            ${LAYERDIR}/recipes-*/*/*.bbappend"

BBFILE_COLLECTIONS += "meta-acme"
BBFILE_PATTERN_meta-acme = "^${LAYERDIR}/"
BBFILE_PRIORITY_meta-acme = "6"

LAYERDEPENDS_meta-acme = "core"
LAYERSERIES_COMPAT_meta-acme = "kirkstone"
```

## conf/local.conf.sample
```bitbake
MACHINE ?= "r2d2"

DISTRO_FEATURES = " "

IMAGE_CLASSES += "image_types_tegra"
IMAGE_FSTYPES = "tegraflash"
```

## conf/machine/r2d2.conf
```bitbake
#@TYPE: Machine
#@NAME: R2-D2 droid
#@DESCRIPTION: R2-D2 droid platform

require conf/machine/include/orin-nano.inc
require conf/machine/include/devkit-wifi.inc

# This is required for tegra-flashvars
MACHINEOVERRIDES =. "jetson-orin-nano-devkit:"
TEGRA_SPIFLASH_BOOT ?= "1"
TNSPEC_BOOTDEV_DEFAULT ?= "mmcblk1p1"
TEGRAFLASH_SDCARD_SIZE ?= "32G"
PARTITION_LAYOUT_TEMPLATE_DEFAULT ?= "flash_t234_qspi_sd.xml"
```
